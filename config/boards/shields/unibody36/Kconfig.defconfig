## config/boards/shields/unibody36/Kconfig.defconfig
```kconfig
# Copyright (c) 2024
# SPDX-License-Identifier: MIT

if SHIELD_UNIBODY36

config ZMK_KEYBOARD_NAME
    default "Unibody 36"

endif
```

## config/boards/shields/unibody36/Kconfig.shield
```kconfig
# Copyright (c) 2024
# SPDX-License-Identifier: MIT

config SHIELD_UNIBODY36
    def_bool $(shields_list_contains,unibody36)
```
