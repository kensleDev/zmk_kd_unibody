/*
 * ULTRA MINIMAL - Just 1 key test
 * If this doesn't boot, we have a fundamental hardware/pin issue
 */

#include <dt-bindings/zmk/matrix_transform.h>

/ {
    chosen {
        zmk,kscan = &kscan0;
        zmk,matrix_transform = &default_transform;
    };

    default_transform: keymap_transform_0 {
        compatible = "zmk,matrix-transform";
        columns = <1>;
        rows = <1>;
        map = <RC(0,0)>;
    };

    kscan0: kscan {
        compatible = "zmk,kscan-gpio-matrix";
        label = "KSCAN";
        wakeup-source;
        diode-direction = "row2col";

        // Use the safest, most common pins
        // P1.13 for row, P0.24 for column
        row-gpios = <&gpio1 13 GPIO_ACTIVE_HIGH>;
        col-gpios = <&gpio0 24 (GPIO_ACTIVE_HIGH | GPIO_PULL_DOWN)>;
    };
};
