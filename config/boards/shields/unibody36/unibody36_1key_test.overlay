/*
 * ULTRA MINIMAL TEST - Just 1 key!
 * This tests if nice!nano can boot with our pin choices
 * Replace unibody36.overlay with this temporarily
 */

#include <dt-bindings/zmk/matrix_transform.h>

/ {
    chosen {
        zmk,kscan = &kscan0;
        zmk,matrix_transform = &default_transform;
    };

    default_transform: keymap_transform_0 {
        compatible = "zmk,matrix-transform";
        columns = <1>;
        rows = <1>;
        map = <RC(0,0)>;
    };

    kscan0: kscan {
        compatible = "zmk,kscan-gpio-matrix";
        label = "KSCAN";
        diode-direction = "col2row";

        // Test with just ONE row and ONE column
        // Using pins that are definitely safe
        row-gpios = <&gpio0 10 (GPIO_ACTIVE_HIGH | GPIO_PULL_DOWN)>;  // P0.10
        col-gpios = <&gpio0 24 GPIO_ACTIVE_HIGH>;  // P0.24
    };
};
